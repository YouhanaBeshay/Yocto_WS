## build-rpi/conf/bblayers.conf
```bitbake
# POKY_BBLAYERS_CONF_VERSION is increased each time build/conf/bblayers.conf
# changes incompatibly
POKY_BBLAYERS_CONF_VERSION = "2"

BBPATH = "${TOPDIR}"
BBFILES ?= ""

BBLAYERS ?= " \
  /home/youhana/YOCTO/poky/meta \
  /home/youhana/YOCTO/poky/meta-poky \
  /home/youhana/YOCTO/poky/meta-yocto-bsp \
  /home/youhana/YOCTO/meta-raspberrypi \
  /home/youhana/YOCTO/meta-test \
  /home/youhana/YOCTO/meta-openembedded/meta-oe \
  /home/youhana/YOCTO/meta-openembedded/meta-python \
  /home/youhana/YOCTO/meta-qt6 \
  /home/youhana/YOCTO/meta-qtcalc \
  /home/youhana/YOCTO/meta-ros/meta-ros-common \
  /home/youhana/YOCTO/meta-ros/meta-ros2 \
  /home/youhana/YOCTO/meta-ros/meta-ros2-humble \
  "
```

## meta-qtcalc/conf/distro/okos.conf
```bitbake
# CUSTOM OS Based on Poky refrence
DISTRO = "okos"
DISTRO_NAME = "OK OS (A Simple -Okay- OS)"
DISTRO_VERSION = "1.0.0"
DISTRO_CODENAME = "scarthgap"


MAINTAINER = " Youhana Beshay <youhanabeshay@gmail.com>"




# Override these in poky based distros
POKY_DEFAULT_DISTRO_FEATURES = "opengl ptest multiarch wayland vulkan"
POKY_DEFAULT_EXTRA_RDEPENDS = "packagegroup-core-boot"
POKY_DEFAULT_EXTRA_RRECOMMENDS = "kernel-module-af-packet"

DISTRO_FEATURES ?= "${DISTRO_FEATURES_DEFAULT} ${POKY_DEFAULT_DISTRO_FEATURES}"

PREFERRED_VERSION_linux-yocto ?= "6.6%"
PREFERRED_VERSION_linux-yocto-rt ?= "6.6%"

SDK_NAME = "${DISTRO}-${TCLIBC}-${SDKMACHINE}-${IMAGE_BASENAME}-${TUNE_PKGARCH}-${MACHINE}"
SDKPATHINSTALL = "/opt/${DISTRO}/${SDK_VERSION}"

DISTRO_EXTRA_RDEPENDS += "${POKY_DEFAULT_EXTRA_RDEPENDS}"
DISTRO_EXTRA_RRECOMMENDS += "${POKY_DEFAULT_EXTRA_RRECOMMENDS}"

TCLIBCAPPEND = ""

PACKAGE_CLASSES ?= "package_rpm"

SANITY_TESTED_DISTROS ?= " \
            ubuntu-22.04 \n \
            "
# add poky sanity bbclass
INHERIT += "poky-sanity"

# QA check settings - a little stricter than the OE-Core defaults
# (none currently necessary as we now match OE-Core)
#WARN_TO_ERROR_QA = "X"
#WARN_QA_remove = "${WARN_TO_ERROR_QA}"
#ERROR_QA_append = " ${WARN_TO_ERROR_QA}"

require conf/distro/include/poky-world-exclude.inc
require conf/distro/include/no-static-libs.inc
require conf/distro/include/yocto-uninative.inc
require conf/distro/include/security_flags.inc
INHERIT += "uninative"

BB_SIGNATURE_HANDLER ?= "OEEquivHash"
BB_HASHSERVE ??= "auto"

# systemd (from https://stackoverflow.com/questions/71031311/enable-systemd-service-in-yocto)
DISTRO_FEATURES:append = " systemd usrmerge "
DISTRO_FEATURES_BACKFILL_CONSIDERED += "sysvinit"
VIRTUAL-RUNTIME_init_manager = "systemd"
VIRTUAL-RUNTIME_initscripts = "systemd-compat-units"


# extra features
DISTRO_FEATURES:append = " alsa wifi ipv4 ipv6 systemd-resolved"

# weston features
DISTRO_FEATURES:append = " pam "
```

## meta-qtcalc/conf/layer.conf
```bitbake
# We have a conf and classes directory, add to BBPATH
BBPATH .= ":${LAYERDIR}"

# We have recipes-* directories, add to BBFILES
BBFILES += "${LAYERDIR}/recipes-*/*/*.bb \
            ${LAYERDIR}/recipes-*/*/*.bbappend"

BBFILE_COLLECTIONS += "meta-qtcalc"
BBFILE_PATTERN_meta-qtcalc = "^${LAYERDIR}/"
BBFILE_PRIORITY_meta-qtcalc = "6"

LAYERDEPENDS_meta-qtcalc = "core qt6-layer"
LAYERSERIES_COMPAT_meta-qtcalc = "scarthgap"
```
